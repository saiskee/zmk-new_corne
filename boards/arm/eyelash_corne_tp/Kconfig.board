## boards/arm/eyelash_corne_tp/Kconfig.board
```kconfig
#
# Copyright (c) 2024 The ZMK Contributors
# SPDX-License-Identifier: MIT
#

config BOARD_EYELASH_CORNE_TP_LEFT
    bool "eyelash_corne tp left"
    depends on SOC_NRF52840_QIAA

config BOARD_EYELASH_CORNE_TP_RIGHT
    bool "eyelash_corne tp right"
    depends on SOC_NRF52840_QIAA
```

## boards/arm/eyelash_corne_tp/Kconfig.defconfig
```kconfig
#
# Copyright (c) 2024 The ZMK Contributors
# SPDX-License-Identifier: MIT
#

# We want to make the right side, which has the trackpoint
# the central side

if BOARD_EYELASH_CORNE_TP_LEFT

config ZMK_KEYBOARD_NAME
    default "KeeCorneTp"

config ZMK_SPLIT_ROLE_CENTRAL
    default y

endif # BOARD_EYELASH_CORNE_TP_RIGHT

# Options that should be enabled on both sides
if BOARD_EYELASH_CORNE_TP_LEFT || BOARD_EYELASH_CORNE_TP_RIGHT

config BOARD
    default "eyelash_corne_tp"

config BOARD_ENABLE_DCDC
    bool "Enable DCDC mode"
    select SOC_DCDC_NRF52X
    default y

config BOARD_ENABLE_DCDC_HV
    bool "Enable High Voltage DCDC converter"
    default y
    select SOC_DCDC_NRF52X_HV
    depends on (BOARD_EYELASH_CORNE_TP_LEFT || BOARD_EYELASH_CORNE_TP_RIGHT)

config ZMK_SLEEP
    default y

config ZMK_SPLIT
    default y

config BT_CTLR
    default BT

if USB

config USB_NRFX
    default y

config USB_DEVICE_STACK
    default y

endif # USB

if ZMK_BACKLIGHT

config PWM
    default y

config LED_PWM
    default y

endif # ZMK_BACKLIGHT

endif # BOARD_EYELASH_CORNE_TP_LEFT || BOARD_EYELASH_CORNE_TP_RIGHT
```
